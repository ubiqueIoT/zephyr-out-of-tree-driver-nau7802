## CMakeLists.txt
```
cmake_minimum_required(VERSION 3.20.0)

list(APPEND ZEPHYR_EXTRA_MODULES "${CMAKE_CURRENT_SOURCE_DIR}/drivers")

find_package(Zephyr REQUIRED HINTS $ENV{ZEPHYR_BASE})

project(nau7802-test-delete-me)

target_sources(app PRIVATE src/main.c)
```

## prj.conf
```kconfig
# Config logger
CONFIG_LOG=y

# Sensor
CONFIG_SENSOR=y

CONFIG_I2C=y
CONFIG_SPI=y
CONFIG_NAU7802=y
# # Interrut triggerred configurations
CONFIG_NAU7802_TRIGGER_NONE=y
CONFIG_NAU7802_TRIGGER_OWN_THREAD=y
CONFIG_NAU7802_TRIGGER_GLOBAL_THREAD=y
CONFIG_NAU7802_TRIGGER_DIRECT=y
```

## src/main.c
```c
#include <zephyr/kernel.h>
#include <zephyr/drivers/gpio.h>
#include <zephyr/drivers/sensor.h>
#include <zephyr/drivers/i2c.h>
#include <zephyr/logging/log.h>
/* this is for getting the SENSOR_CHAN_FORCE*/
#include "../drivers/sensor/nau7802/nau7802.h"

LOG_MODULE_REGISTER(main_logging);

int main(void)
{
        const struct device *const nau7802 = DEVICE_DT_GET_ONE(nuvoton_nau7802);

        if (!device_is_ready(nau7802))
        {
                LOG_ERR("sensor: device not ready.");
                return 0;
        }
        return 0;
}
```
